## Kconfig
```kconfig
mainmenu "RT-Thread Configuration"

config BSP_DIR
    string
    option env="BSP_ROOT"
    default "."

config WIOTA_PS_DIR
    string
    option env="WIOTA_PS_ROOT"
    default "PS"

config RTT_DIR
    string
    option env="RTT_ROOT"
    default "rt-thread"

source "$RTT_DIR/Kconfig"
source "$WIOTA_PS_DIR/Kconfig"
source "board/Kconfig"
source "applications_example/Kconfig"
```

## PS/Kconfig
```kconfig
menu "wiota PS"

config _FPGA_
    bool "default open(_FPGA_)"
    default y

config _RT_THREAD_
    bool "RT_Thread default open(_RT_THREAD_)"
    default y

config _ALLOW_TRACE_PRITF_TEST_
    bool "default open(_ALLOW_TRACE_PRITF_TEST_)"
    default y

config UC8288_FACTORY
    bool "factory mode,recv and send test, default open(UC8288_FACTORY)"
    default y

config _L1_FACTORY_FUNC_
    bool "factory mode, default open(_L1_FACTORY_FUNC_)"
    default y

config _CLK_GATING_
    bool "clk gating, default open(_CLK_GATING_)"
    default y

endmenu
```

## app/Kconfig
```kconfig
menu "wiota APP DEMO"

config WIOTA_APP_DEMO
    bool "app demo mcro(WIOTA_APP_DEMO)"
    default y

config APP_DEMO_LIGHT
    bool "app demo light mcro(APP_DEMO_LIGHT)"
    default y

config APP_DEMO_SWITCH
    bool "app demo switch mcro(APP_DEMO_SWITCH)"
    default y

endmenu
```

## applications/Kconfig
```kconfig
menu "wiota APP"

config UC8288_MODULE
    bool "use at cmd, default open(UC8288_MODULE)"
    default y

if RT_USING_ADC
    config _ADC_APP_
        bool "open adc, default close(_ADC_APP_)"
        default n
endif

if RT_USING_CAN
    config _CAN_APP_
        bool "open can, default close(_CAN_APP_)"
        default n
endif

if RT_USING_DAC
    config _DAC_APP_
        bool "open dac, default close(_DAC_APP_)"
        default n
endif

if RT_USING_I2C
    config _IIC_APP_
        bool "open i2c, default close(_IIC_APP_)"
        default n
endif

if RT_USING_PIN
    config _PIN_APP_
        bool "open pin, default close(_PIN_APP_)"
        default n
endif

if RT_USING_WDT
    config _WATCHDOG_APP_
        bool "open wdt, default close(_WATCHDOG_APP_)"
        default n
endif

if RT_USING_RTC
    config _RTC_APP_
        bool "open rtc, default close(_RTC_APP_)"
        default n
endif

if RT_USING_PWM
    config _PWM_APP_
        bool "open pwm, default close(_PWM_APP_)"
        default n
endif

config _SPI_FLASH_APP_
    bool "open spi, default close(_SPI_FLASH_APP_)"
    default n

if RT_USING_SPI
    config _SPIM_FLASH_APP_
        bool "open spi master, default close(_SPIM_FLASH_APP_)"
        default n
endif

config _RS485_APP_
    bool "open rs485, default close(_RS485_APP_)"
    default n

config _UART_APP_
    bool "open uart, default close(_UART_APP_)"
    default n

endmenu
```

## applications_example/Kconfig
```kconfig
menu "Application Example Config"

    config APP_EXAMPLE_PIN
        bool "Enable PIN Example"
        default n

    config APP_EXAMPLE_UART
        bool "Enable UART Example"
        default n

    config APP_EXAMPLE_I2C
        bool "Enable I2C Example"
        default n

    config APP_EXAMPLE_SPI
        bool "Enable SPI Example"
        default n

    config APP_EXAMPLE_ADC
        bool "Enable ADC Example"
        default n

    config APP_EXAMPLE_DAC
        bool "Enable DAC Example"
        default n

    config APP_EXAMPLE_RTC
        bool "Enable RTC Example"
        default n

    config APP_EXAMPLE_WATCHDOG
        bool "Enable Watchdog Example"
        default n

    config APP_EXAMPLE_PWM
        bool "Enable PWM Example"
        default n

    config APP_EXAMPLE_FLASH
        bool "Enable Flash Example"
        default n

    config APP_EXAMPLE_HWTIMER
        bool "Enable HwTimer Example"
        default n

    config APP_EXAMPLE_RW
        bool "Enable RW Example"
        default n

endmenu
```

## board/Kconfig
```kconfig
menu "Hardware Drivers Config"

config SOC_UC8288
    bool
    select SOC_SERIES_UC8288
    select RT_USING_COMPONENTS_INIT
    select RT_USING_USER_MAIN
    default y

menu "Onboard Peripheral Drivers"

    config BSP_USING_SERIAL
        bool "Enable USART (uart0)"
        select RT_USING_SERIAL
        select BSP_USING_UART
        select BSP_USING_UART0
        default y

endmenu

menu "On-chip Peripheral Drivers"

    config BSP_USING_GPIO
        bool "Enable GPIO"
        select RT_USING_PIN
        default y

    menuconfig BSP_USING_UART
        bool "Enable UART"
        default n
        if BSP_USING_UART
            config BSP_USING_UART0
                bool "Enable UART0"
                default y
            config BSP_USING_UART1
                bool "Enable UART1"
                default n
        endif

    menuconfig BSP_USING_I2C
        bool "Enable I2C"
        default n
        select RT_USING_I2C
        if BSP_USING_I2C
            choice
                prompt "Select i2c pins"
                default BSP_USING_SOFT_I2C_PIN_GROUP

                config BSP_USING_HARD_I2C_PIN_GROUP_1
                    bool "Hard i2c pin group 1 (SCL: GPIO5, SDA: GPIO6)"

                config BSP_USING_HARD_I2C_PIN_GROUP_2
                    bool "Hard i2c pin group 2 (SCL: GPIO4, SDA: GPIO14)"

                config BSP_USING_SOFT_I2C_PIN_GROUP
                    bool "Soft i2c pin group"
                    select RT_USING_I2C_BITOPS
                    select RT_USING_PIN
                    if BSP_USING_SOFT_I2C_PIN_GROUP
                        config BSP_SOFT_I2C_SCL_PIN
                            int "i2c SCL pin number"
                            range 0 18
                            default 2
                        config BSP_SOFT_I2C_SDA_PIN
                            int "I2C SDA pin number"
                            range 0 18
                            default 3
                    endif
            endchoice
        endif

    menuconfig BSP_USING_SPI
        bool "Enable SPI"
        default n
        select RT_USING_SPI
        if BSP_USING_SPI
            choice
                prompt "Select spi pins"
                default BSP_USING_HARD_SPI_PIN_GROUP_1

                config BSP_USING_HARD_SPI_PIN_GROUP_1
                    bool "Hard spi pin group 1 (SCK: GPIO0, MOSI: GPIO3, MISO: GPIO2)"

                config BSP_USING_HARD_SPI_PIN_GROUP_2
                    bool "Hard spi pin group 2 (SCK: GPIO8, MOSI: GPIO9, MISO: GPIO10)"

                config BSP_USING_SOFT_SPI_PIN_GROUP
                    bool "Soft spi pin group"
                    select RT_USING_SPI_BITOPS
                    select RT_USING_PIN
                    if BSP_USING_SOFT_SPI_PIN_GROUP
                        config BSP_SOFT_SPI_SCK_PIN
                            int "spi SCK pin number"
                            range 0 18
                            default 0
                        config BSP_SOFT_SPI_MOSI_PIN
                            int "spi MOSI pin number"
                            range 0 18
                            default 3
                        config BSP_SOFT_SPI_MISO_PIN
                            int "spi MISO pin number"
                            range 0 18
                            default 2
                    endif
            endchoice
        endif

    config BSP_USING_ADC
        bool "Enable ADC"
        default n
        select RT_USING_ADC

    config BSP_USING_DAC
        bool "Enable DAC"
        default n
        select RT_USING_DAC

    config BSP_USING_RTC
        bool "Enable RTC"
        default n
        select RT_USING_RTC

    config BSP_USING_WDT
        bool "Enable WDT"
        default n
        select RT_USING_WDT

    menuconfig BSP_USING_PWM
        bool "Enable PWM"
        default n
        select RT_USING_PWM
        if BSP_USING_PWM
            config BSP_USING_PWM0
                bool "Enable PWM0 (GPIO15)"
                default n
            config BSP_USING_PWM1
                bool "Enable PWM1 (GPIO16)"
                default n
            config BSP_USING_PWM2
                bool "Enable PWM2 (GPIO17)"
                default n
            config BSP_USING_PWM3
                bool "Enable PWM3 (GPIO18)"
                default n
        endif

    config BSP_USING_ON_CHIP_FLASH
        bool "Enable On-chip Flash"
        default n

    menuconfig BSP_USING_HWTIMER
        bool "Enable Hardware Timer"
        default n
        select RT_USING_HWTIMER
        if BSP_USING_HWTIMER
            config BSP_USING_HWTIMER1
                bool "Enable Hardware Timer1 (TIMER1)"
                default y
        endif

endmenu

endmenu
```

## rt-thread/components/elec_dev/Kconfig
```kconfig
menu "electricity_device"
	menuconfig USING_ELEC_DEV
		bool 	"USING_ELEC_DEV  (please click y or n)"
		default n
		
		if USING_ELEC_DEV
			choice
				prompt "select electricity device mode"
				default ELEC_DEV_CCO_MODE

				config ELEC_DEV_CCO_MODE
					bool	"ELEC_DEV_CCO_MODE"	
					
				config ELEC_DEV_METER_MODE
					bool	"ELEC_DEV_METER_MODE"
					
				config ELEC_DEV_CTRLER_MODE
					bool	"ELEC_DEV_CTRLER_MODE"
					
				comment	"ELEC_DEV_CCO_MODE-->using as a concentrator"
				comment "ELEC_DEV_METER_MODE-->using as a meter"
				comment "ELEC_DEV_CTRLER_MODE-->using as a controller"
			endchoice
			
			config ELEC_DEV_COM_NAME
				string	"com name for elec dev"
				default	"uart1"

			config ELEC_DEV_TRANS_MAX_LEN
				int	"com transfer max len"
				range 12 300
				default	256

			choice
				prompt "elec dev uart com baudrate"
				default ELEC_DEV_BAUD_2400
				
				config ELEC_DEV_BAUD_2400
					bool	"ELEC_DEV_BAUD_2400"
					
				config ELEC_DEV_BAUD_4800
					bool	"ELEC_DEV_BAUD_4800"
					
				config ELEC_DEV_BAUD_9600
					bool	"ELEC_DEV_BAUD_9600"	
					
				config ELEC_DEV_BAUD_115200
					bool	"ELEC_DEV_BAUD_115200"						
			endchoice
				
			choice
				prompt "elec dev uart com parity"
				default ELEC_DEV_PARITY_EVEN
				
				config ELEC_DEV_PARITY_EVEN
					bool	"ELEC_DEV_PARITY_EVEN"
					
				config ELEC_DEV_PARITY_NONE
					bool	"ELEC_DEV_PARITY_NONE"
					
				config ELEC_DEV_PARITY_ODD
					bool	"ELEC_DEV_PARITY_ODD"					
			endchoice	
			
		endif	
endmenu
```
